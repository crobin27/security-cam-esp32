## esp32/main/Kconfig.projbuild
```kconfig
menu "Wi-Fi Configuration"

    config WIFI_SSID
        string "Wi-Fi SSID"
        default "Your_SSID"
        help
            Enter your Wi-Fi SSID here.
    
    config WIFI_PASSWORD
        string "Wi-Fi Password"
        default "Your_Password"
        help
            Enter your Wi-Fi password here.
    
    endmenu

    menu "AWS Configuration"

        config AWS_API_URL
            string "AWS API URL"
            default ""
            help
                Enter your AWS API Gateway URL for file uploads.
        
        config AWS_IOT_ENDPOINT
            string "AWS IoT Endpoint"
            default ""
            help 
                Enter your AWS Topic Endpoint
    endmenu
    
```
